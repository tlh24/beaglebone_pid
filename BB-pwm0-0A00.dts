/dts-v1/;
/plugin/;


/ {
	compatible = "ti,beaglebone", "ti,beaglebone-black";
	part-number = "BB-pwm0"; /* pin 9.22 */
	version = "00A0";
	fragment@0 {
		target = <&am33xx_pinmux>;
		__overlay__ {
			pinctrl_spec: Panel_Pins {
				pinctrl-single,pins = <
				/*0x020 0x04*/ /* P8_19 MODE4 ehrpwm2A PWM */
				0x150 0x33 /* P9_22 Mode3 ehrpwm0A PWM */
			/* P9_27_qep_pin: pinmux_P9_27_qep_pin */
			/* pinctrl-single,pins = <0x1a4  0x21>;*/	/* Mode 1, Pull-Down, RxActive */
			/* P9_41_gpio_pin: pinmux_P9_41_gpio_pin */
			/* pinctrl-single,pins = <0x1b4  0x2F>; */	/* Mode 7, RxActive */
			>;
			};
		};
	};

};


